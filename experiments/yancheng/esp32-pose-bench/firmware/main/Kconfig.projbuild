## experiments/yancheng/esp32-pose-bench/firmware/main/Kconfig.projbuild
```kconfig
menu "Yancheng pose benchmark"
    config BENCH_POSE
        bool "Run a custom C-target INT8 YOLO11n-Pose model"
        default n
        help
            Requires a model exported for target=c and its matching manifest.
            Disabled builds only measure hardware/camera acquisition, never inference FPS.
    config BENCH_SAMPLES
        int "Measured frames"
        range 1 10000
        default 10
    config BENCH_WARMUP
        int "Warmup frames excluded from measurements"
        range 0 100
        default 2
endmenu
```

## experiments/yancheng/esp32-pose-bench/firmware/sdkconfig.defaults
```kconfig
CONFIG_IDF_TARGET="esp32"
CONFIG_ESPTOOLPY_FLASHSIZE_4MB=y
CONFIG_ESPTOOLPY_FLASHMODE_DIO=y
CONFIG_ESPTOOLPY_FLASHFREQ_40M=y
CONFIG_PARTITION_TABLE_CUSTOM=y
CONFIG_PARTITION_TABLE_CUSTOM_FILENAME="partitions.csv"
CONFIG_COMPILER_OPTIMIZATION_PERF=y
CONFIG_ESP_DEFAULT_CPU_FREQ_MHZ_240=y
CONFIG_ESP_MAIN_TASK_STACK_SIZE=16384
CONFIG_SPIRAM=y
CONFIG_SPIRAM_BOOT_INIT=y
CONFIG_SPIRAM_IGNORE_NOTFOUND=y
CONFIG_SPIRAM_USE_MALLOC=y
CONFIG_SPIRAM_SPEED_40M=y
CONFIG_ESP_TASK_WDT_EN=n
CONFIG_LOG_DEFAULT_LEVEL_WARN=y
CONFIG_BENCH_SAMPLES=10
CONFIG_BENCH_WARMUP=2
```
